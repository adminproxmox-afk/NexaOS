## linux/configs/nexaos_defconfig
```kconfig
BR2_x86_pentiumpro=y
BR2_REPRODUCIBLE=y
BR2_TOOLCHAIN_EXTERNAL=y
BR2_TOOLCHAIN_EXTERNAL_BOOTLIN=y
BR2_TOOLCHAIN_EXTERNAL_BOOTLIN_X86_I686_MUSL_STABLE=y
BR2_DOWNLOAD_FORCE_CHECK_HASHES=y
BR2_GLOBAL_PATCH_DIR="$(BR2_EXTERNAL_NEXAOS_PATH)/board/nexaos/hashes"
BR2_TARGET_GENERIC_HOSTNAME="nexaos"
BR2_TARGET_GENERIC_ISSUE=""
BR2_ROOTFS_DEVICE_CREATION_DYNAMIC_EUDEV=y
# BR2_TARGET_ENABLE_ROOT_LOGIN is not set
# BR2_TARGET_GENERIC_GETTY is not set
BR2_SYSTEM_DHCP=""
BR2_ROOTFS_USERS_TABLES="$(BR2_EXTERNAL_NEXAOS_PATH)/board/nexaos/users.txt"
BR2_ROOTFS_OVERLAY="$(BR2_EXTERNAL_NEXAOS_PATH)/rootfs-overlay"
BR2_ROOTFS_POST_BUILD_SCRIPT="$(BR2_EXTERNAL_NEXAOS_PATH)/board/nexaos/post-build.sh"
BR2_LINUX_KERNEL=y
BR2_LINUX_KERNEL_CUSTOM_VERSION=y
BR2_LINUX_KERNEL_CUSTOM_VERSION_VALUE="6.12.27"
BR2_LINUX_KERNEL_USE_CUSTOM_CONFIG=y
BR2_LINUX_KERNEL_CUSTOM_CONFIG_FILE="$(BR2_EXTERNAL_NEXAOS_PATH)/board/nexaos/linux.config"
BR2_LINUX_KERNEL_BZIMAGE=y
BR2_PACKAGE_XORG7=y
BR2_PACKAGE_XSERVER_XORG_SERVER=y
BR2_PACKAGE_XSERVER_XORG_SERVER_MODULAR=y
BR2_PACKAGE_XDRIVER_XF86_INPUT_EVDEV=y
BR2_PACKAGE_XAPP_XINIT=y
BR2_PACKAGE_XAPP_XSETROOT=y
BR2_PACKAGE_XTERM=y
BR2_TARGET_ROOTFS_CPIO=y
BR2_TARGET_ROOTFS_CPIO_GZIP=y
# BR2_TARGET_ROOTFS_TAR is not set
```
